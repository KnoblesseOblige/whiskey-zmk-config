## config/boards/arm/whiskey/Kconfig.board
```kconfig
# Copyright (c) 2021 KnoblesseOblige
# SPDX-License-Identifier: MIT

config BOARD_WHISKEY
	bool "Whiskey"
	depends on SOC_NRF52840_QIAA
```

## config/boards/arm/whiskey/Kconfig.defconfig
```kconfig
# Copyright (c) 2021 KnoblesseOblige
# SPDX-License-Identifier: MIT

if BOARD_WHISKEY

config ZMK_KEYBOARD_NAME
	default "Whiskey"

if USB

config USB_NRFX
	default y

config USB_DEVICE_STACK
	default y

endif # USB

config BT_CTLR
	default BT

config ZMK_BLE
	default y

config ZMK_USB
	default y

config ZMK_BATTERY_VOLTAGE_DIVIDER
	default y

config ZMK_RGB_UNDERGLOW
  default y

config WS2812_STRIP
  default y

endif # BOARD_WHISKEY
```
